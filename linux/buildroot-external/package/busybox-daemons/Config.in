## linux/buildroot-external/package/busybox-daemons/Config.in
```kconfig
config BR2_PACKAGE_BUSYBOX_DAEMONS
	bool "BusyBox build for the resident daemons"
	depends on BR2_PACKAGE_BUSYBOX
	help
	  A second, minimal BusyBox with only init, inetd, syslogd and
	  udhcpd.  On NOMMU each process holds a private copy of its
	  binary's text, so the daemons that stay resident cost a fraction
	  of the full BusyBox image each (#23).
```

## linux/buildroot-external/package/busybox-tools/Config.in
```kconfig
config BR2_PACKAGE_BUSYBOX_TOOLS
	bool "BusyBox build for the interactive tools"
	depends on BR2_PACKAGE_BUSYBOX
	help
	  A third BusyBox with the everyday commands the main image leaves
	  out to stay small (awk, less, tar, gzip, wget, top, free, pgrep,
	  diff, ip, ...).  On NOMMU every exec copies its binary's text, so
	  these stay out of the main BusyBox that every shell and script
	  runs from, and cost memory only while one of them runs.
	  Applets the main BusyBox has keep pointing at it.
```
